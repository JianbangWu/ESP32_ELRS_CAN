## components/ds3231m/Kconfig.projbuild
```kconfig
menu "RTC Configuration"

    config PIN_SCL
        int "SCL GPIO number"
        default 16

    config PIN_SDA
        int "SDA GPIO number"
        default 15

    config PIN_INT
        int "CLK GPIO number"
        default 13

    config PIN_RST
        int "RST GPIO number"
        default 12

    config PIN_RTC_CLK
        int "32KHz CLK GPIO number"
        default 17

    config ADDR_RTC
        hex "CHIP I2C ADDR NOT SHIFTED"
        default 0x68


endmenu
```

## components/elrs/Kconfig.projbuild
```kconfig
menu "ELRS Configuration"

    config ELRS_PIN_TX
        int "UART TX GPIO number"
        default 1

    config ELRS_PIN_RX
        int "UART RX GPIO number"
        default 2
        
    config ELRS_BAUDRATE
        int "UART BAUDRATE"
        default 420000

    config ELRS_UART_PORT
        int "UART PORT"
        default 1
        
    config ELRS_UART_TX_BUFF_SIZE
        int "Buffer Size"
        default 1024
        help
            Buffer Size In KByte

    config ELRS_UART_RX_BUFF_SIZE
        int "Buffer Size"
        default 1024
        help
            Buffer Size In KByte

    config DEBUG_ENABLE_SERIAL_OUTPUT
        bool "debug - draw channels in serial"
        default N

endmenu
```

## components/sd_card/Kconfig.projbuild
```kconfig
menu "SD/MMC Configuration"

    config FORMAT_IF_MOUNT_FAILED
        bool "Format the card if mount failed"
        default n
        help
            If this config item is set, format_if_mount_failed will be set to true and the card will be formatted if
            the mount has failed.

    config FORMAT_SD_CARD
        bool "Format the card as a part of the example"
        default n
        help
            If this config item is set, the card will be formatted as a part of the example.

    config ENABLE_DETECT_FEATURE
        bool "Enable Detect feature"
        default n
        help
            If you are using the detecting pin in SD-Card Slot.

    choice SDMMC_BUS_WIDTH
        prompt "SD/MMC bus width"
        default SDMMC_BUS_WIDTH_4
        help
            Select the bus width of SD or MMC interface.
            Note that even if 1 line mode is used, D3 pin of the SD card must have a pull-up resistor connected.
            Otherwise the card may enter SPI mode, the only way to recover from which is to cycle power to the card.

        config SDMMC_BUS_WIDTH_4
            bool "4 lines (D0 - D3)"

        config SDMMC_BUS_WIDTH_1
            bool "1 line (D0)"
    endchoice

    choice SDMMC_SPEED_MODE
        prompt "SD/MMC speed mode"
        default SDMMC_SPEED_DS

        config SDMMC_SPEED_DS
            bool "Default Speed"
        config SDMMC_SPEED_HS
            bool "High Speed"
        config SDMMC_SPEED_UHS_I_SDR50
            bool "UHS-I SDR50 (100 MHz, 50 MB/s)"
            depends on SOC_SDMMC_UHS_I_SUPPORTED
        config SDMMC_SPEED_UHS_I_DDR50
            bool "UHS-I DDR50 (50 MHz, 50 MB/s)"
            depends on SOC_SDMMC_UHS_I_SUPPORTED
    endchoice

    if SOC_SDMMC_USE_GPIO_MATRIX
        config PIN_DET
            depends on ENABLE_DETECT_FEATURE 
            int "DET GPIO number"
            default 48

        config PIN_CMD
            int "CMD GPIO number"
            default 14

        config PIN_CLK
            int "CLK GPIO number"
            default 13

        config PIN_D0
            int "D0 GPIO number"
            default 12

        if SDMMC_BUS_WIDTH_4

            config PIN_D1
                int "D1 GPIO number"
                default 11 

            config PIN_D2
                int "D2 GPIO number"
                default 47 


            config PIN_D3
                int "D3 GPIO number"
                default 21 

        endif  # SDMMC_BUS_WIDTH_4

    endif  # SOC_SDMMC_USE_GPIO_MATRIX

    config DEBUG_PIN_CONNECTIONS
        bool "Debug sd pin connections and pullup strength"
        default n

    if !SOC_SDMMC_USE_GPIO_MATRIX
        config PIN_CMD
            depends on DEBUG_PIN_CONNECTIONS
            default 15 if IDF_TARGET_ESP32

        config PIN_CLK
            depends on DEBUG_PIN_CONNECTIONS
            default 14 if IDF_TARGET_ESP32

        config PIN_D0
            depends on DEBUG_PIN_CONNECTIONS
            default 2 if IDF_TARGET_ESP32

        if SDMMC_BUS_WIDTH_4

            config PIN_D1
                depends on DEBUG_PIN_CONNECTIONS
                default 4 if IDF_TARGET_ESP32

            config PIN_D2
                depends on DEBUG_PIN_CONNECTIONS
                default 12 if IDF_TARGET_ESP32

            config PIN_D3
                depends on DEBUG_PIN_CONNECTIONS
                default 13 if IDF_TARGET_ESP32

        endif  # SDMMC_BUS_WIDTH_4
    endif

    config ENABLE_ADC_FEATURE
        bool "Enable ADC feature"
        depends on DEBUG_PIN_CONNECTIONS
        default y if IDF_TARGET_ESP32
        default n

    config ADC_UNIT
        int "ADC Unit"
        depends on ENABLE_ADC_FEATURE
        default 1 if IDF_TARGET_ESP32
        default 1

    config ADC_PIN_CLK
        int "CLK mapped ADC pin"
        depends on ENABLE_ADC_FEATURE
        default 6 if IDF_TARGET_ESP32
        default 1

    config ADC_PIN_CMD
        int "CMD mapped ADC pin"
        depends on ENABLE_ADC_FEATURE
        default 3 if IDF_TARGET_ESP32
        default 1

    config ADC_PIN_D0
        int "D0 mapped ADC pin"
        depends on ENABLE_ADC_FEATURE
        default 2 if IDF_TARGET_ESP32
        default 1

    if SDMMC_BUS_WIDTH_4

        config ADC_PIN_D1
            int "D1 mapped ADC pin"
            depends on ENABLE_ADC_FEATURE
            default 0 if IDF_TARGET_ESP32
            default 1

        config ADC_PIN_D2
            int "D2 mapped ADC pin"
            depends on ENABLE_ADC_FEATURE
            default 5 if IDF_TARGET_ESP32
            default 1

        config ADC_PIN_D3
            int "D3 mapped ADC pin"
            depends on ENABLE_ADC_FEATURE
            default 4 if IDF_TARGET_ESP32
            default 1

    endif  # SDMMC_BUS_WIDTH_4

    config SD_PWR_CTRL_LDO_INTERNAL_IO
        depends on SOC_SDMMC_IO_POWER_EXTERNAL
        bool "SD power supply comes from internal LDO IO (READ HELP!)"
        default y
        help
            Only needed when the SD card is connected to specific IO pins which can be used for high-speed SDMMC.
            Please read the schematic first and check if the SD VDD is connected to any internal LDO output.
            Unselect this option if the SD card is powered by an external power supply.

    config SD_PWR_CTRL_LDO_IO_ID
        depends on SOC_SDMMC_IO_POWER_EXTERNAL && SD_PWR_CTRL_LDO_INTERNAL_IO
        int "LDO ID"
        default 4
        help
            Please read the schematic first and input your LDO ID.
endmenu
```
